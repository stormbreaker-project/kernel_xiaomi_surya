/*
 * TouchScreen Device Tree For Xiaomi J20
 */

&soc {
	xiaomi_touch {
		status = "ok";
		compatible = "xiaomi-touch";
		touch,name = "xiaomi-touch";
	};
};

&qupv3_se0_spi {
	status = "ok";

	touchscreen {
		status = "ok";
		compatible = "novatek,NVT-ts-spi";
		reg = <0 >;	//Same as CS ID

		/* SPI Configuration */
		spi-max-frequency = <8000000 >;	//4800000,5000000,8000000,9600000,15000000,19200000

		/* regulator Configuration */
		touch_vddio-supply = <&L18A>;
		touch_lab-supply = <&lcdb_ldo_vreg>;
		touch_ibb-supply = <&lcdb_ncp_vreg>;

		/*Novatek GPIO Configuration */
		novatek,reset-gpio = <&tlmm 8 0x00>;
		novatek,irq-gpio = <&tlmm 9 0x2001>;

		/* 525 */
		//novatek,swrst-n8-addr = <0x01F01A>;

		/* 672A, 525B, 675, 526 */
		novatek,swrst-n8-addr = <0x03F0FE>;
		novatek,spi-rd-fast-addr = <0x03F310>;

	};
};
